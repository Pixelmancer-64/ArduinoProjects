#include <Ultrasonic.h>

#include <dhtnew.h>
#include <avr/pgmspace.h>
#include <TimerOne.h> 

DHTNEW mySensor(1);
Ultrasonic ultrassom(8,7) ;
int DataPin = 4;  //Ligar o pino 4 do Arduino ao DIN do modulo
int ClockPin = 5; //Ligar o pino 5 do Arduino ao CLK do módulo
int LoadPin = 6;  //Ligar o pino 6 do Arduinio ao pino CS/Load do módulo
const int LM35 = A0;
float temperatura;
int buzzer  = 12;

int presenca = 10; 
 
byte buffer[8];


int doo = 262;

int re = 294;
int mi = 330;
int fa = 349;
int sol = 392;
int la = 440;
int si = 494;


const static byte font[][8] PROGMEM = {
  {B00000000, B00000000, B00000000, B00000000, B00000000, B00000000, B00000000, B00000000},
  {B00000100, B00000100, B00000100, B00000100, B00000100, B00000100, B00000000, B00000100},
  {B00001010, B00001010, B00001010, B00000000, B00000000, B00000000, B00000000, B00000000},
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  {B00000000, B00000000, B00000000, B00001010, B00011110, B00010100, B00000000, B00000000}
};

void clearDisplay()
{
  for (byte x = 0; x < 8; x++)
  {
    buffer[x] = B00000000;
  }
  screenUpdate();
}

void initMAX7219()
{
  pinMode(DataPin, OUTPUT);
  pinMode(LoadPin, OUTPUT);
  pinMode(ClockPin, OUTPUT);
  pinMode(presenca, INPUT);
  clearDisplay();
  writeData(B00001011, B00000111);
  writeData(B00001001, B00000000);
  writeData(B00001100, B00000001);
  intensity(1);
}

void intensity(int intensity)
{
  writeData(B00001010, intensity);
}

void writeData(byte MSB, byte LSB)
{
  byte mask;
  digitalWrite(LoadPin, LOW);

  for (mask = B10000000; mask > 0; mask >>= 1)
  {
    digitalWrite(ClockPin, LOW);
    if (MSB & mask)
    {
      digitalWrite(DataPin, HIGH);
    }
    else
    {
      digitalWrite(DataPin, LOW);
    }
    digitalWrite(ClockPin, HIGH);
  }

  for (mask = B10000000; mask > 0; mask >>= 1)
  {
    digitalWrite(ClockPin, LOW);
    if (LSB & mask)
    {
      digitalWrite(DataPin, HIGH);
    }
    else
    {
      digitalWrite(DataPin, LOW);
    }
    digitalWrite(ClockPin, HIGH);
  }
  digitalWrite(LoadPin, HIGH);
  digitalWrite(ClockPin, LOW);
}

void scroll(char myString[], int speed)
{
  byte firstChrRow, secondChrRow;
  byte ledOutput;
  byte chrPointer = 0;
  byte Char1, Char2;
  byte scrollBit = 0;
  byte strLength = 0;
  unsigned long time;
  unsigned long counter;

  while (myString[strLength]) {
    strLength++;
  }
  counter = millis();
  while (chrPointer < (strLength - 1))
  {
    time = millis();
    if (time > (counter + speed))
    {
      Char1 = myString[chrPointer];
      Char2 = myString[chrPointer + 1];
      for (byte y = 0; y < 8; y++)
      {
        firstChrRow = pgm_read_byte(&font[Char1 - 32][y]);
        secondChrRow = (pgm_read_byte(&font[Char2 - 32][y])) << 1;
        ledOutput = (firstChrRow << scrollBit) | (secondChrRow >> (8 - scrollBit) );
        buffer[y] = ledOutput;
      }
      scrollBit++;
      if (scrollBit > 6)
      {
        scrollBit = 0;
        chrPointer++;
      }
      counter = millis();
    }
  }
}

void screenUpdate()
{
  for (byte row = 0; row < 8; row++)
  {
    writeData(row + 1, buffer[row]);
  }
}

void setup()
{
  initMAX7219();
  Timer1.initialize(10000);
  Timer1.attachInterrupt(screenUpdate);
  Serial.begin(9600);
  pinMode(buzzer, OUTPUT);
}

void loop()
{
  if(digitalRead(presenca) == HIGH)
  {
    tone(buzzer,doo, 500);
    delay(500);
    tone(buzzer,re, 500);
    delay(500);
    tone(buzzer,mi, 500);
    delay(500);
    tone(buzzer,fa, 500);
    delay(600);
    tone(buzzer,fa, 500);
    delay(300);
    tone(buzzer,fa, 500);
    delay(600);
    tone(buzzer,doo, 500);
    delay(500);
    tone(buzzer,re, 500);
    delay(500);
    tone(buzzer,doo, 500);
    delay(500);
    tone(buzzer,re, 500);
    delay(500);
    tone(buzzer,re, 500);
    delay(300);
    tone(buzzer,re, 500);
    delay(600);
    tone(buzzer,doo, 500);
    delay(500);
    tone(buzzer,sol, 500);
    delay(500);
    tone(buzzer,fa, 500);
    delay(500);
    tone(buzzer,mi, 500);
    delay(600);
    tone(buzzer,mi, 500);
    delay(300);
    tone(buzzer,mi, 500);
    delay(600);
     tone(buzzer,doo, 500);
    delay(500);
    tone(buzzer,re, 500);
    delay(500);
    tone(buzzer,mi, 500);
    delay(500);
    tone(buzzer,fa, 500);
    delay(600);
    tone(buzzer,fa, 500);
    delay(300);
    tone(buzzer,fa, 500);
    delay(60
    0);
    
    scroll("ENCONTRADO", 100);
  }
  

   temperatura = (float(analogRead(LM35)) * 5/(1023))/0.01;
   String temp(temperatura);
   char temp1[20];
   temp.toCharArray(temp1, 20);
   String T = String(temperatura); 
   //scroll(temp1, 100);

   String dis(ultrassom.Ranging(CM));
   char dis1[20];
   dis.toCharArray(dis1, 20);
   //scroll(dis1, 100);
  
  //delay(2000);
}
